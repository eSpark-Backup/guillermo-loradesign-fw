/dts-v1/;
#include <nordic/nrf5340_cpuapp_qkaa.dtsi>
#include "basestation-pinctrl.dtsi"
#include "basestation_common.dtsi"

/ {
	model = "Custom Board auto generated by nRF Connect for VS Code (CPUAPP)";
	compatible = "eSpark,basestation-cpuapp";

	chosen {
		zephyr,sram = &sram0_image;
		zephyr,flash = &flash0;
		zephyr,code-partition = &slot0_partition;
		zephyr,sram-secure-partition = &sram0_s;
		zephyr,sram-non-secure-partition = &sram0_ns;
	};
};

#include "basestation-cpuapp_partitioning.dtsi"
#include "basestation-shared_sram.dtsi"
