## Firmware-Development/nRF-Connect/BaseStation-Board/boards/eSpark/basestation/board.yml
```yaml
board:
  name: basestation
  vendor: eSpark
  socs:
  - name: nrf5340
    variants:
    - name: ns
      cpucluster: cpuapp
```
